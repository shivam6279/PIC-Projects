#ifndef _OLED_H_
#define _OLED_H_

/*
I2C 128x64 OLED LCD
Requires I2C.h and XC.h
*/

void write_int(int a, unsigned char precision);
void write_float(double a, unsigned char left, unsigned char right);
void oled_command(unsigned char dom);
void oled_write(unsigned char data);
void clear_display();
void init_oled();
void set_xy(unsigned char row, unsigned char col);
void write_line(unsigned char data);
void write_char(unsigned char a);
void write_str(const unsigned char *string);

unsigned char characters[][8]={//Too much data for PIC16
    {0x00,0x00,0x00,0x00,0x00},//  
    {0x00,0x5F,0x00,0x00,0x00},//!
    {0x00,0x07,0x00,0x07,0x00},//"
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    {0x41,0x36,0x08,0x00,0x00},//}
};

void write_int(int a, unsigned char precision){
    if(a < 0){
        a *= (-1);
        send_char('-');
    }
    else{
        send_char('+');
    }
    if(precision >= 6) send_char(((a / 100000) % 10) + 48);
    if(precision >= 5) send_char(((a / 10000) % 10) + 48);
    if(precision >= 4) send_char(((a / 1000) % 10) + 48);
    if(precision >= 3) send_char(((a / 100) % 10) + 48);
    if(precision >= 2) send_char(((a / 10) % 10) + 48);
    if(precision >= 1) send_char((a % 10) + 48);
}

void write_float(double a, unsigned char left, unsigned char right){
    unsigned char i;
    long int tens = 10;
    if(a < 0){
        a *= (-1);
        send_char('-');
    }
    else{
        send_char('+');
    }    
    if(left >= 7) send_char(((int)(a / 1000000) % 10) + 48);
    if(left >= 6) send_char(((int)(a / 100000) % 10) + 48);
    if(left >= 5) send_char(((int)(a / 10000) % 10) + 48);
    if(left >= 4) send_char(((int)(a / 1000) % 10) + 48);
    if(left >= 3) send_char(((int)(a / 100) % 10) + 48);
    if(left >= 2) send_char(((int)(a / 10) % 10) + 48);
    if(left >= 1) send_char(((int)a % 10) + 48);
    send_char('.');
    for(i = 0; i < right; i++){
        send_char(((long int)(a * tens) % 10) + 48);
        tens *= 10;
    }
}

void oled_command(unsigned char data){ 
   i2c_start(); 
   i2c_send(0x78); 
   i2c_send(0x00); 
   i2c_send(data); 
   i2c_stop(); 
} 

void write_str(const unsigned char *string){
    while(*string != '\0'){
        send_char(*string);
        string++;
    }
}

void write_char(unsigned char a){
    unsigned char i;
    send_line(0);
    for(i = 0; i < 5; i++){
        send_line(characters[a - 32][i]);
    }
}

void init_oled(){
    oled_command(0xae); 
    oled_command(0xa8); 
    oled_command(0x3f); 
    oled_command(0xd3); 
    oled_command(0x00); 
    oled_command(0x40); 
    oled_command(0xa0); 
    oled_command(0xa1); 
    oled_command(0xc0); 
    oled_command(0xc8); 
    oled_command(0xda); 
    oled_command(0x12); 
    oled_command(0x81); 
    oled_command(0xFF); 
    oled_command(0xa4); 
    oled_command(0xa6); 
    oled_command(0xd5); 
    oled_command(0x80); 
    oled_command(0x8d); 
    oled_command(0x14); 
    oled_command(0xAF); 
    oled_command(0x20); 
    oled_command(0x00); 
}

void oled_write(unsigned char data){ 
    int i; 
    oled_command(0x21) ; 
    oled_command(0x00); 
    oled_command(127); 
    oled_command(0x22) ; 
    oled_command(0x00); 
    oled_command(7); 
    i2c_start (); 
    i2c_send(0x78) ; 
    i2c_send(0x40) ; 
    for(i = 0; i < 1024; i++){ 
        i2c_send(data); 
    } 
     i2c_stop (); 
} 

void set_xy(unsigned char row, unsigned char col){
    i2c_start();
    i2c_send(0x78);
    i2c_send(0x00);
    i2c_send(0xB0 + row);
    i2c_stop();
    i2c_start();
    i2c_send(0x78);
    i2c_send(0x00);
    i2c_send((col & 0x0F));
    i2c_stop();
    i2c_start();
    i2c_send(0x78);
    i2c_send(0x00);
    i2c_send(0x10 + ((col >> 4) & 0x0F));
    i2c_stop();
}

void write_line(unsigned char data){
    i2c_start();
    i2c_send(0x78);
    i2c_send(0x40);
    i2c_send(data);
    i2c_stop();
}

#endif


